VERSION ""

NS_ :

BS_:

BU_:

BO_ 3221225472 VECTOR__INDEPENDENT_SIG_MSG: 0 Vector__XXX
 SG_ zielonexd : 0|1@1+ (1,0) [0|1] "" Vector__XXX

EV_ Red_P_W: 0 [0|1] "" 0 1 DUMMY_NODE_VECTOR0 Vector__XXX;

EV_ Red_P_S: 0 [0|1] "" 0 2 DUMMY_NODE_VECTOR0 Vector__XXX;

EV_ Red_P_N: 0 [0|0] "" 0 3 DUMMY_NODE_VECTOR0 Vector__XXX;

EV_ Red_P_E: 0 [0|1] "" 0 4 DUMMY_NODE_VECTOR0 Vector__XXX;

EV_ Green_W_s: 0 [0|0] "" 0 5 DUMMY_NODE_VECTOR0 Vector__XXX;

EV_ Yellow_W_s: 0 [0|0] "" 0 6 DUMMY_NODE_VECTOR0 Vector__XXX;

EV_ Yellow_W_p: 0 [0|1] "" 0 7 DUMMY_NODE_VECTOR0 Vector__XXX;

EV_ Red_W_p: 0 [0|1] "" 0 8 DUMMY_NODE_VECTOR0 Vector__XXX;

EV_ Green_S_s: 0 [0|1] "" 0 9 DUMMY_NODE_VECTOR0 Vector__XXX;

EV_ Yellow_S_s: 0 [0|1] "" 0 10 DUMMY_NODE_VECTOR0 Vector__XXX;

EV_ Green_S_p: 0 [0|1] "" 0 11 DUMMY_NODE_VECTOR0 Vector__XXX;

EV_ Yellow_S_p: 0 [0|1] "" 0 12 DUMMY_NODE_VECTOR0 Vector__XXX;

EV_ Green_N_s: 0 [0|1] "" 0 13 DUMMY_NODE_VECTOR0 Vector__XXX;

EV_ Red_N_s: 0 [0|1] "" 0 14 DUMMY_NODE_VECTOR0 Vector__XXX;

EV_ Red_N_p: 0 [0|1] "" 0 15 DUMMY_NODE_VECTOR0 Vector__XXX;

EV_ Green_N_p: 0 [0|1] "" 0 16 DUMMY_NODE_VECTOR0 Vector__XXX;

EV_ Green_E_s: 0 [0|1] "" 0 17 DUMMY_NODE_VECTOR0 Vector__XXX;

EV_ Yellow_E_s: 0 [0|1] "" 0 18 DUMMY_NODE_VECTOR0 Vector__XXX;

EV_ Red_E_p: 0 [0|1] "" 0 19 DUMMY_NODE_VECTOR0 Vector__XXX;

EV_ Yellow_E_p: 0 [0|1] "" 0 20 DUMMY_NODE_VECTOR0 Vector__XXX;

EV_ Green_P_N: 0 [0|0] "" 0 21 DUMMY_NODE_VECTOR0 Vector__XXX;

EV_ Red_W_s: 0 [0|0] "" 0 22 DUMMY_NODE_VECTOR0 Vector__XXX;

EV_ Green_P_E: 0 [0|1] "" 0 23 DUMMY_NODE_VECTOR0 Vector__XXX;

EV_ Green_E_p: 0 [0|1] "" 0 24 DUMMY_NODE_VECTOR0 Vector__XXX;

EV_ Yellow_N_s: 0 [0|1] "" 0 25 DUMMY_NODE_VECTOR0 Vector__XXX;

EV_ Red_S_p: 0 [0|1] "" 0 26 DUMMY_NODE_VECTOR0 Vector__XXX;

EV_ Red_S_s: 0 [0|1] "" 0 27 DUMMY_NODE_VECTOR0 Vector__XXX;

EV_ Green_P_S: 0 [0|1] "" 0 28 DUMMY_NODE_VECTOR0 Vector__XXX;

EV_ Red_E_s: 0 [0|1] "" 0 29 DUMMY_NODE_VECTOR0 Vector__XXX;

EV_ Green_W_p: 0 [0|1] "" 0 30 DUMMY_NODE_VECTOR0 Vector__XXX;

EV_ Green_P_W: 0 [0|1] "" 0 31 DUMMY_NODE_VECTOR0 Vector__XXX;

EV_ Yellow_N_p: 0 [0|1] "" 0 32 DUMMY_NODE_VECTOR0 Vector__XXX;

CM_ BO_ 3221225472 "This is a message for not used signals, created by Vector CANdb++ DBC OLE DB Provider.";
