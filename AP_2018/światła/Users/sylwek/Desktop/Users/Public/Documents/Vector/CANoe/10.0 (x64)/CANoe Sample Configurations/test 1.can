/*@!Encoding:1250*/
includes
{
  
}

variables
{
  message 0x1 Switch_WE;  //wysyłanie wiadomości o zmianie świateł dla wschód-zachód
  message 0x3 Switch_NS;  //wysyłanie wiadomości o zmianie świateł dla północ-połódnie
  timer trwanie;//timer dotyczący trwania fazy zanim dojdzie do zmiany świateł
  int faza;
}               

on start
{
  @Natezenie_S=1;
  @Natezenie_N=1;
  @Natezenie_E=1;
  @Natezenie_W=1;
  faza=1;
  setTimer(trwanie,2*@Natezenie_S);
}
on message 2
{
  if(@Red_W_s==0 && @Red_E_s==1) //jedzie tylko zachód (wsyzstkie kierunki)
  {
    faza=1;
    setTimer(trwanie,2*@Natezenie_W);
  }
  if(@Red_W_s==1 && @Red_E_s==1) //jadą prosto i wschód i zachód (tylko prosto)
  {
    faza=1;
    if(@Natezenie_W>=@Natezenie_E)    setTimer(trwanie,3*@Natezenie_W);
    else     setTimer(trwanie,3*@Natezenie_E);
  }
  if(@Red_W_s==1 && @Red_E_s==0) //jedzie tylko wschód (wszystkie kierunki)
  {
    faza=1;
    setTimer(trwanie,2*@Natezenie_E);
  }
}
on message 4                    //takie samo rozwiązanie jak dla wschód-zachód
{
  if(@Red_S_s==0 && @Red_N_s==1)
  {
    faza=2;
    setTimer(trwanie,2*@Natezenie_S);
  }
  if(@Red_S_s==1 && @Red_N_s==1)
  {
    faza=2;
    if(@Natezenie_S>=@Natezenie_N)    setTimer(trwanie,3*@Natezenie_S);
    else setTimer(trwanie,3*@Natezenie_N);
  }
  if(@Red_S_s==1 && @Red_N_s==0)
  {
    faza=2;
    setTimer(trwanie,2*@Natezenie_N);
  }
}
on timer trwanie
{
   switch(faza){
    case 1:
      output(Switch_WE);
      break;
    case 2:
      output(Switch_NS);
      break;
  }

}