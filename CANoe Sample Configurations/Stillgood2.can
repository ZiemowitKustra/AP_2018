/*@!Encoding:1250*/
includes
{
  
}

variables
{
  message 0x10 stillgood;
  message 0x12 LightError;
  msTimer ComunicationError;
  msTimer Light_Error;
  byte dziala=1;
}

on start
{
  setTimer(ComunicationError,1000);
  setTimer(Light_Error,1000);
}

on message 19
{
  //Ustaw światła na (migające) żółte
}

//timer ustawiany przy rozkazie zmiany świateł
on timer Light_Error
{
  //if (światło danego koloru != tym co kazano)
  {
    //Ustaw świadła na (migające) zółte
    //output 303;
  }
}

on message 17
{
  if(dziala==1){
  setTimer(ComunicationError,10);
  output(stillgood);
  write("17");
  }
}

on timer ComunicationError
{
  if(dziala==1)
  write("Wyłączam noda 2");
}

//psuj noda 2
on key 'b'
{
  dziala=0;
  write("node 2 wyleciał w powietrze");
  //ILNodeControlStop(M); //Wyłącza danego noda (M to nazwa mojego noda)
  //Niestety nie mam pojęcia jak to działa :(
}