/*@!Encoding:1250*/
includes
{
  
}

variables
{
  message 0x11 stillgood={dlc=1};
  message 0x13 LightError;
  msTimer ComunicationError;
  msTimer Light_Error;
  byte dziala;
  
}

on start
{
  dziala=1;
  setTimer(ComunicationError,1000);
//  setTimer(Light_Error,1000);
  output(stillgood);
  write("Poszlo still good");
}

on message 18
{
  //Ustaw światła na (migające) żółte
}

//timer ustawiany przy rozkazie zmiany świateł
on timer Light_Error
{
  //if (światło danego koloru != tym co kazano)
  {
    //Ustaw świadła na (migające) zółte
    //output 303;
  }
}

on message 16
{
  if(dziala==1){
  write("Przyszlo");
  setTimer(ComunicationError,10);
  output(stillgood);
  write("16");
  }
}

on timer ComunicationError
{
  if(dziala==1)
  write("Wyłączam noda 1");
}

//psuj noda 1
on key 'a'
{
  dziala=0;
  write("Node 1 wyleciał w powietrze");
}