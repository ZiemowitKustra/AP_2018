/*@!Encoding:1250*/
includes
{
  
}

variables
{
  message 0x300 stillgood;
  message 0x303 LightError;
  msTimer ComunicationError;
  msTimer LightError;
  
}

on start
{
  setTimer(ComunicationError,1000);
  setTimer(LightError,1000);
}

on message 303
{
  //Ustaw światła na (migające) żółte
}

//timer ustawiany przy rozkazie zmiany świateł
on timer LightError
{
  //if (światło danego koloru != tym co kazano)
  {
    //Ustaw świadła na (migające) zółte
    //output 303;
  }
}

on message 300
{
  setTimer(ComunicationError,1);
  output(stillgood);
}

on timer ComunicationError
{
  //Zamigaj światłami zółtymi przez chwilę(np. 3 sec)
  //następnie wyłącz wszystkie światła
}

//psuj noda 1
on key 'a' //'b' dla noda 2
{
  //psuj
}